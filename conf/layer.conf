## conf/layer.conf
```bitbake
# We have a conf and classes directory, add to BBPATH
BBPATH .= ":${LAYERDIR}"

# We have recipes-* directories, add to BBFILES
BBFILES += "${LAYERDIR}/recipes-*/*/*.bb \
            ${LAYERDIR}/recipes-*/*/*.bbappend"

BBFILE_COLLECTIONS += "fus"
BBFILE_PATTERN_fus = "^${LAYERDIR}/"
BBFILE_PRIORITY_fus = "9"
LAYERVERSION_fus = "1"
LAYERSERIES_COMPAT_fus = "mickledore scarthgap"
```
